## main/Kconfig.projbuild
```kconfig
menu "Akita CarNode"

choice AKITA_BOARD_PROFILE
    prompt "Primary board profile"
    default AKITA_BOARD_GENERIC_ESP32S3

    config AKITA_BOARD_GENERIC_ESP32S3
        bool "Generic ESP32-S3"

    config AKITA_BOARD_GENERIC_ESP32C6
        bool "Generic ESP32-C6"

    config AKITA_BOARD_GENERIC_ESP32C5
        bool "Generic ESP32-C5"

    config AKITA_BOARD_HELTEC_LORA32_V2
        bool "Heltec LoRa 32 V2"
endchoice

config AKITA_ENABLE_CONFIG_PORTAL
    bool "Enable built-in config portal"
    default y

config AKITA_CONFIG_PORTAL_SSID
    string "Config portal SSID"
    default "Akita-CarNode-Setup"

config AKITA_CONFIG_PORTAL_PASSWORD
    string "Config portal password"
    default "akita-setup"
    help
        WPA2 requires 8 to 63 characters. Leave empty only if you intentionally want an open setup AP.

endmenu
```

## sdkconfig.defaults
```kconfig
CONFIG_PARTITION_TABLE_CUSTOM=y
CONFIG_PARTITION_TABLE_CUSTOM_FILENAME="partitions.csv"
CONFIG_COMPILER_OPTIMIZATION_SIZE=y
CONFIG_FREERTOS_PLACE_FUNCTIONS_INTO_FLASH=y
CONFIG_RINGBUF_PLACE_FUNCTIONS_INTO_FLASH=y
# CONFIG_ESP_WIFI_IRAM_OPT is not set
# CONFIG_ESP_WIFI_RX_IRAM_OPT is not set
# CONFIG_SPI_MASTER_ISR_IN_IRAM is not set
CONFIG_LOG_DEFAULT_LEVEL_INFO=y
CONFIG_ESPTOOLPY_FLASHSIZE_4MB=y
CONFIG_BT_ENABLED=y
CONFIG_BT_NIMBLE_ENABLED=y
CONFIG_BT_NIMBLE_HOST_TASK_STACK_SIZE=6144
CONFIG_ESP_TASK_WDT_EN=y
CONFIG_ESP_TASK_WDT_TIMEOUT_S=30
CONFIG_MBEDTLS_CERTIFICATE_BUNDLE=y
CONFIG_AKITA_BOARD_GENERIC_ESP32S3=y
CONFIG_AKITA_ENABLE_CONFIG_PORTAL=y
CONFIG_AKITA_CONFIG_PORTAL_PASSWORD="akita-setup"
```
